#include <dt-bindings/zmk/pointing.h>

&trackball_split { status = "disabled"; };
&trackball_listener {
    status = "okay";
    device = <&trackball>;
};

// Sensor-independent USB mouse test on the right-hand 6, 7, 8, 9 keys.
&{/keymap/default_layer} {
    bindings = <
                // Row 1
                &kp ESC    &kp N1     &kp N2     &bt BT_SEL 0    &bt BT_CLR     &bt BT_CLR_ALL
                &mmv MOVE_LEFT     &mmv MOVE_RIGHT     &mmv MOVE_UP     &mmv MOVE_DOWN     &kp N0     &kp DEL

                // Row 2
                &kp TAB    &kp Q      &kp W      &kp E      &kp R      &kp T
                &kp Y      &kp U      &kp I      &kp O      &kp P      &kp BSLH

                // Row 3
                &kp LCTRL  &kp A      &kp S      &kp D      &kp F      &kp G
                &kp H      &kp J      &kp K      &kp L      &kp SEMI   &kp SQT

                // Row 4
                &kp LSHIFT &kp Z      &kp X      &kp C      &kp V      &kp B
                &kp N      &kp M      &kp COMMA  &kp DOT    &kp FSLH   &kp RSHIFT

                // Left thumb cluster: physical positions 48-52
                &kp LALT   &kp SPACE  &kp TAB    &kp LCTRL   &kp LGUI

                // Right thumb cluster: physical positions 53-55
                &kp RET    &kp BSPC   &kp RALT
            >;
};

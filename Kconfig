## Kconfig
```kconfig
config CHARYBDIS_SENSOR_PROBE
    bool "Charybdis USB sensor diagnostic"
    depends on PMW3610_ALT && ZMK_USB && ZMK_USB_LOGGING && !ZMK_SPLIT
    default n
    help
      Diagnostic-only status reporting and scheduled motion reads. Uses private
      structures from the exact PMW3610 revision pinned in config/west.yml.

config CHARYBDIS_ORIENTATION
    bool "Correct Charybdis diagonal trackball orientation"
    default y
    depends on ZMK_POINTING && ZMK_SPLIT_ROLE_CENTRAL
    depends on DT_HAS_ZMK_CHARYBDIS_ORIENTATION_ENABLED
```

## boards/shields/Kconfig.defconfig
```kconfig
if SHIELD_CHARYBDIS_LEFT

config ZMK_KEYBOARD_NAME
    default "Charybdis Wireless"

endif

if SHIELD_CHARYBDIS_RIGHT

config ZMK_KEYBOARD_NAME
    default "Charybdis Wireless"

endif
```

## boards/shields/charybdis/Kconfig.shield
```kconfig
config SHIELD_CHARYBDIS_LEFT
    def_bool $(shields_list_contains,charybdis_left)

config SHIELD_CHARYBDIS_RIGHT
    def_bool $(shields_list_contains,charybdis_right)

if SHIELD_CHARYBDIS_LEFT

config ZMK_KEYBOARD_NAME
    default "Charybdis"

config ZMK_SPLIT_ROLE_CENTRAL
    default y

endif

if SHIELD_CHARYBDIS_LEFT || SHIELD_CHARYBDIS_RIGHT

config ZMK_SPLIT
    default y

endif
```

## config/west.yml
```yaml
manifest:
  remotes:
    - name: zmkfirmware
      url-base: https://github.com/zmkfirmware
    - name: badjeff
      url-base: https://github.com/badjeff

  projects:
    - name: zmk
      remote: zmkfirmware
      revision: 9ebbeff0a8b69a42f14aec022cdf16c7a107b9e0
      import: app/west.yml

    - name: zmk-pmw3610-driver
      remote: badjeff
      revision: e970029b42f33613ca8f05baf311dc733cd5a390

  self:
    path: config
```

## dts/bindings/input/zmk,charybdis-orientation.yaml
```yaml
description: Charybdis diagonal motion correction on the split central
compatible: "zmk,charybdis-orientation"
include: base.yaml
properties:
  device:
    type: phandle
    required: true
    description: Source of relative X and Y input events
```
